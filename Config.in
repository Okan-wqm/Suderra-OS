## board/suderra/aarch64-revpi-connect4/revpi-connect4.its
```
/*
 * Suderra OS - signed FIT of the Revolution Pi Connect 4 (ADR-0007, ADR-048 DEC-8.7)
 *
 * The template scripts/production-artifacts.sh fills for one RAUC slot
 * (arm-pre-genimage; board-boot.conf names it). Where the generic ARM producer
 * emits one signed configuration per stock board tree it finds, the Connect 4
 * has exactly one: the board's final device tree, the KUNBUS CM4 tree with the
 * revpi-connect4 overlay merged by fdtoverlay (arm-board-dtb). A raw CM4 tree
 * is never a configuration of this FIT: booted on a Connect 4 it has no PiBridge,
 * no TPM, no RTC and no RS485.
 *
 * U-Boot verifies the configuration signature (required = "conf") over the
 * kernel, the device tree and the ramdisk before it boots; the ramdisk is the
 * dm-verity initramfs, and the device tree carries the kernel command line (its
 * root hash among it) as /chosen/bootargs: U-Boot reads no bootargs property of a
 * FIT configuration, so the producer puts the command line into the signed tree.
 *
 * Placeholders (all replaced, none may remain in the output):
 *   @SLOT@      A or B
 *   @KERNEL@    path of the kernel Image
 *   @INITRD@    path of the slot's gzip verity initramfs
 *   @FDT@       path of the board's final device tree with the slot's kernel
 *               command line in /chosen/bootargs
 *
 * The configuration's compatible is the final device tree's own root
 * compatible: arm-board-dtb fails the build if the two differ, so this line
 * cannot drift from what the overlay sets.
 */

/dts-v1/;
/ {
    description = "Suderra signed FIT, Revolution Pi Connect 4 (slot @SLOT@)";
    #address-cells = <1>;
    images {
        kernel {
            data = /incbin/("@KERNEL@");
            type = "kernel"; arch = "arm64"; os = "linux"; compression = "none";
            load = <0x00080000>; entry = <0x00080000>;
            hash-1 { algo = "sha256"; };
        };
        ramdisk-1 {
            data = /incbin/("@INITRD@");
            type = "ramdisk"; arch = "arm64"; os = "linux"; compression = "gzip";
            hash-1 { algo = "sha256"; };
        };
        fdt-revpi-connect4 {
            data = /incbin/("@FDT@");
            type = "flat_dt"; arch = "arm64"; compression = "none";
            hash-1 { algo = "sha256"; };
        };
    };
    configurations {
        default = "conf-revpi-connect4";
        conf-revpi-connect4 {
            description = "Revolution Pi Connect 4 (slot @SLOT@)";
            compatible = "kunbus,revpi-connect4", "brcm,bcm2711";
            kernel = "kernel"; fdt = "fdt-revpi-connect4"; ramdisk = "ramdisk-1";
            signature-1 {
                algo = "sha256,rsa2048";
                key-name-hint = "fit-signing";
                sign-images = "kernel", "fdt", "ramdisk";
                required = "conf";
            };
        };
    };
};
```

## package/revpi-picontrol/Config.in
```kconfig
config BR2_PACKAGE_REVPI_PICONTROL
	bool "revpi-picontrol"
	depends on BR2_LINUX_KERNEL
	depends on BR2_aarch64
	help
	  KUNBUS piControl, the Revolution Pi PiBridge master and
	  process-image driver. It creates /dev/piControl0, through which
	  the edge agent's revpi-io backend reads and writes the process
	  image of the Revolution Pi Connect 4 and the modules on its
	  PiBridge (ADR-048 DEC-8.8).

	  piControl is an out-of-tree module and is not part of the KUNBUS
	  kernel tree: it is built against the pinned KUNBUS kernel of the
	  same image as a signed module (the build's module signing key
	  signs it in modules_install, so a kernel that enforces module
	  signatures loads it) and is loaded at boot by
	  systemd-modules-load.

	  The package version is the piControl release that KUNBUS builds
	  for the pinned kernel; it must be bumped together with the kernel
	  (docs/hardware/revpi-connect4.md).

	  https://gitlab.com/revolutionpi/piControl

comment "revpi-picontrol needs a Linux kernel and an aarch64 target"
	depends on !BR2_LINUX_KERNEL || !BR2_aarch64
```

## package/suderra-keys/Config.in
```kconfig
config BR2_PACKAGE_SUDERRA_KEYS
	bool "suderra-keys"
	default n
	help
	  Suderra OS imajı için gerekli public key/sertifika'ları
	  hedef rootfs'e kurar.

	  Kurulan dosyalar:
	  - /etc/rauc/keyring.pem        (RAUC bundle doğrulama)
	  - /etc/ssl/certs/suderra-ca.pem (Cloud broker mTLS CA)
	  - /etc/dm-verity/pubkey.pem    (verity root hash doğrulama)
	  - /etc/suderra/os-installer-payload.ed25519.pub
	  - /etc/suderra/os-update-manifest.ed25519.pub
	  - /etc/suderra/recovery-escrow.pub.pem (the public key the recovery
	    keys of /data are escrowed to, ADR-048 DEC-14.3; its private half
	    lives offline in the HSM)
	  - /etc/suderra/keys/<purpose>/<epoch>.pub for edge-release,
	    edge-provisioning, fleet-root and device-lifecycle (ADR-048
	    DEC-3.4): the dev/CI keys of SUDERRA_TRUST_ROOTS_DIR/edge on dev
	    images; on production images only keyids the P1 key ceremony
	    inventories (none yet, so none is pinned)

	  Anahtarlar SUDERRA_TRUST_ROOTS_DIR env var ile belirtilir.
	  DEV variant: ~/.suderra-keys/dev/
	  PROD variant: CI'da kısa-ömürlü HSM session'dan elde edilir ve
	  suderra-keys.profile dosyası "prod" içermelidir.
```

## package/suderra-os-installer/Config.in
```kconfig
config BR2_PACKAGE_SUDERRA_OS_INSTALLER
	bool "suderra-os-installer"
	depends on BR2_INIT_SYSTEMD
	depends on BR2_PACKAGE_HOST_RUSTC_TARGET_ARCH_SUPPORTS
	depends on BR2_TOOLCHAIN_HAS_THREADS
	select BR2_PACKAGE_HOST_RUSTC
	select BR2_PACKAGE_UTIL_LINUX
	select BR2_PACKAGE_UTIL_LINUX_BINARIES
	select BR2_PACKAGE_XZ
	help
	  Runtime verifier plus USB-booted self-installer for Suderra OS
	  appliances. The suderra-installer verifier validates signed USB
	  payload and Edge provisioning manifests; the suderra-os-install
	  helper selects a safe SD/eMMC target, writes the target image,
	  verifies the written image prefix, and powers off.

if BR2_PACKAGE_SUDERRA_OS_INSTALLER

config BR2_PACKAGE_SUDERRA_OS_INSTALLER_CLOUD_ENDPOINT
	string "provisioning API base URL"
	default ""
	help
	  https base URL of the provisioning API the root installer
	  fetches signed deliveries from (ADR-048 DEC-5.5; contracts
	  delivery.json network: GET <base>/install/<code>/suderra-os).
	  post-build.sh writes it to /etc/suderra/cloud-endpoint on every
	  image with a board_profile and fails the build when it is empty
	  or not an https URL; it is a fact of the signed image, never of
	  the environment (DEC-19). Production boards use the platform's
	  PROVISIONING_API_BASE_URL; the QEMU targets use the QEMU fake
	  cloud, whose certificate chains to the dev provisioning-API CA
	  that package/suderra-keys installs on dev and ci-board images.

endif

comment "suderra-os-installer needs systemd, threads, and a Rust-supported target"
	depends on !BR2_INIT_SYSTEMD || !BR2_TOOLCHAIN_HAS_THREADS || !BR2_PACKAGE_HOST_RUSTC_TARGET_ARCH_SUPPORTS
```

## package/suderra-rauc-config/Config.in
```kconfig
config BR2_PACKAGE_SUDERRA_RAUC_CONFIG
	bool "suderra-rauc-config"
	depends on BR2_INIT_SYSTEMD
	depends on BR2_PACKAGE_RAUC
	depends on BR2_PACKAGE_SUDERRA_OTA
	depends on BR2_PACKAGE_SUDERRA_OS_INSTALLER
	help
	  Suderra OS RAUC runtime configuration for A/B rootfs slots.
	  Its health gate and single mark-good path need suderra-ota
	  (pending-OTA decisions) and suderra-installer (the OS and
	  agent health predicate), ADR-048 DEC-6.8.

comment "suderra-rauc-config needs systemd, rauc, suderra-ota and suderra-os-installer"
	depends on !BR2_INIT_SYSTEMD || !BR2_PACKAGE_RAUC || \
		!BR2_PACKAGE_SUDERRA_OTA || !BR2_PACKAGE_SUDERRA_OS_INSTALLER
```
