## configs/suderra_aarch64_rpi4_prod_ab_defconfig
```kconfig
#
# Suderra OS — Raspberry Pi 4 / CM4 PRODUCTION defconfig (aarch64, ADR-0007)
# PROD variant: signed-FIT + GPT A/B + dm-verity + LUKS. Locked appliance
# (no dropbear/getty). Built ONLY via the gated arm-production-build.yml with
# HSM signing; excluded from the standard per-PR Image Build. Dev builds use
# suderra_aarch64_rpi4_defconfig (unchanged).
#
# Hedef donanım: Raspberry Pi 4 Model B, Compute Module 4 (CM4),
#                CM4 IO Board, CM4-based custom carrier'lar.
#
# SoC: Broadcom BCM2711 (4x Cortex-A72 @ 1.5 GHz, 1/2/4/8 GB LPDDR4)
#
# Boot zinciri:
#   1. ROM bootloader (Pi SPI EEPROM)
#   2. start4.elf (close-source GPU firmware)
#   3. config.txt -> kernel=Image
#   4. cmdline.txt -> kernel command line
#   5. Linux 6.12 LTS (Suderra hardening fragment)
#   6. systemd -> Edge Agent
#
# Boyut hedefleri (uncompressed):
#   - Boot partition: ~80 MB (firmware blobs + kernel + DTB)
#   - Rootfs:        ~80-120 MB (Faz 1), ~50 MB (Faz 3 sonu)
#
# Build:
#   ./scripts/build-in-docker.sh suderra_aarch64_rpi4_defconfig
#
# Flash:
#   sudo ./scripts/flash-sd.sh /dev/sdX \
#     output/suderra_aarch64_rpi4_defconfig/images/sdcard.img.xz
#

# ============================================================================
# Architecture — Cortex-A72 (BCM2711)
# ============================================================================
BR2_aarch64=y
BR2_cortex_a72=y
BR2_ARM_FPU_VFPV4=y
BR2_JLEVEL=4
BR2_CCACHE=y
BR2_PACKAGE_SUDERRA_VARIANT_PROD=y
BR2_GLOBAL_PATCH_DIR="$(BR2_EXTERNAL_SUDERRA_PATH)/board/suderra/buildroot-hashes"
BR2_DOWNLOAD_FORCE_CHECK_HASHES=y

# ============================================================================
# Toolchain — glibc dynamic, required by Buildroot systemd
# ============================================================================
BR2_TOOLCHAIN_BUILDROOT=y
BR2_TOOLCHAIN_BUILDROOT_LIBC="glibc"
BR2_TOOLCHAIN_BUILDROOT_GLIBC=y
BR2_TOOLCHAIN_BUILDROOT_CXX=y
BR2_KERNEL_HEADERS_6_12=y
BR2_BINUTILS_VERSION_2_43_X=y
BR2_GCC_VERSION_13_X=y
BR2_TOOLCHAIN_BUILDROOT_LOCALE=y
BR2_TOOLCHAIN_BUILDROOT_USE_SSP=y

# ============================================================================
# Linux Kernel — Raspberry Pi downstream BCM2711 kernel + Suderra fragment
# ============================================================================
BR2_LINUX_KERNEL=y
BR2_LINUX_KERNEL_CUSTOM_TARBALL=y
BR2_LINUX_KERNEL_CUSTOM_TARBALL_LOCATION="$(call github,raspberrypi,linux,576cc10e1ed50a9eacffc7a05c796051d7343ea4)/linux-576cc10e1ed50a9eacffc7a05c796051d7343ea4.tar.gz"
BR2_LINUX_KERNEL_DEFCONFIG="bcm2711"
BR2_LINUX_KERNEL_CONFIG_FRAGMENT_FILES="$(BR2_EXTERNAL_SUDERRA_PATH)/board/suderra/aarch64-rpi4/linux-rpi4.config $(BR2_EXTERNAL_SUDERRA_PATH)/board/suderra/aarch64-rpi4/linux-rpi4-hardening.config"
BR2_LINUX_KERNEL_IMAGE=y
BR2_LINUX_KERNEL_NEEDS_HOST_OPENSSL=y

# Device trees — Pi 4 B, CM4 base, CM4 IO Board
BR2_LINUX_KERNEL_DTS_SUPPORT=y
BR2_LINUX_KERNEL_INTREE_DTS_NAME="broadcom/bcm2711-rpi-4-b broadcom/bcm2711-rpi-cm4 broadcom/bcm2711-rpi-cm4-io"

# ============================================================================
# U-Boot — signed-FIT root of trust (ADR-0007, gate G1)
# ============================================================================
# BUILD-ONLY at this stage: config.txt still boots the kernel directly until
# PR-A4 flips it to chainload u-boot.bin. Enabling it here proves U-Boot +
# CONFIG_FIT_SIGNATURE compiles for BCM2711 in CI (Image Build job). The FIT
# verification public key is inserted into u-boot.dtb at signing time by
# mkimage -K (PR-A3); RAUC's U-Boot env backend arrives in PR-A5.
BR2_TARGET_UBOOT=y
BR2_TARGET_UBOOT_BUILD_SYSTEM_KCONFIG=y
BR2_TARGET_UBOOT_BOARD_DEFCONFIG="rpi_arm64"
BR2_TARGET_UBOOT_CONFIG_FRAGMENT_FILES="$(BR2_EXTERNAL_SUDERRA_PATH)/board/suderra/aarch64-rpi4/uboot-fragment.config"
BR2_TARGET_UBOOT_NEEDS_OPENSSL=y
BR2_TARGET_UBOOT_NEEDS_DTC=y
BR2_TARGET_UBOOT_FORMAT_BIN=y
BR2_TARGET_UBOOT_FORMAT_DTB=y
BR2_PACKAGE_HOST_UBOOT_TOOLS=y
BR2_PACKAGE_HOST_UBOOT_TOOLS_FIT_SUPPORT=y
BR2_PACKAGE_HOST_UBOOT_TOOLS_FIT_SIGNATURE_SUPPORT=y

# ============================================================================
# Raspberry Pi Firmware (close-source GPU/boot blobs — Broadcom)
# ============================================================================
#
# Pi 4 boot zinciri close-source bir firmware (start4.elf) gerektirir.
# Bu firmware Broadcom tarafından sağlanır ve Buildroot bunu indirir.
# Açık kaynak değildir ancak imzalı ve doğrulanabilirdir.
#
# Suderra OS bu firmware'i değiştirmez — yalnızca config.txt + cmdline.txt'yi
# kontrol eder.

BR2_PACKAGE_RPI_FIRMWARE=y
BR2_PACKAGE_RPI_FIRMWARE_VARIANT_PI4=y
BR2_PACKAGE_RPI_FIRMWARE_CONFIG_FILE="$(BR2_EXTERNAL_SUDERRA_PATH)/board/suderra/aarch64-rpi4/config.txt"
BR2_PACKAGE_RPI_FIRMWARE_CMDLINE_FILE="$(BR2_EXTERNAL_SUDERRA_PATH)/board/suderra/aarch64-rpi4/cmdline.txt"

# ============================================================================
# Init System — systemd (Edge Agent için zorunlu)
# ============================================================================
BR2_INIT_SYSTEMD=y
# BR2_PACKAGE_SYSTEMD_LOGIND is not set
BR2_PACKAGE_SYSTEMD_NETWORKD=y
# BR2_PACKAGE_SYSTEMD_TIMESYNCD is not set
# BR2_PACKAGE_SYSTEMD_HOSTNAMED is not set

# ============================================================================
# Filesystem — Faz 1: ext4, Faz 3: erofs + dm-verity
# ============================================================================
BR2_TARGET_ROOTFS_EXT2=y
BR2_TARGET_ROOTFS_EXT2_4=y
BR2_TARGET_ROOTFS_EXT2_GEN=4
BR2_TARGET_ROOTFS_EXT2_LABEL="suderra-root"
BR2_TARGET_ROOTFS_EXT2_SIZE="256M"
BR2_TARGET_ROOTFS_EXT2_INODES=0
BR2_TARGET_ROOTFS_EXT2_RESBLKS=1

# ============================================================================
# Image üretimi (genimage)
# ============================================================================
BR2_PACKAGE_HOST_GENIMAGE=y
BR2_PACKAGE_HOST_DOSFSTOOLS=y
BR2_PACKAGE_HOST_MTOOLS=y

# ============================================================================
# Rootfs overlay + post-build / post-image scripts
# ============================================================================
BR2_ROOTFS_OVERLAY="$(BR2_EXTERNAL_SUDERRA_PATH)/board/suderra/common/rootfs-overlay"
BR2_ROOTFS_POST_BUILD_SCRIPT="$(BR2_EXTERNAL_SUDERRA_PATH)/board/suderra/common/post-build.sh"
BR2_ROOTFS_POST_IMAGE_SCRIPT="$(BR2_EXTERNAL_SUDERRA_PATH)/board/suderra/common/post-image.sh"
BR2_ROOTFS_POST_SCRIPT_ARGS="suderra_aarch64_rpi4_prod_ab"
BR2_ROOTFS_USERS_TABLES="$(BR2_EXTERNAL_SUDERRA_PATH)/board/suderra/common/users.txt"

# ============================================================================
# Network tools (Faz 2'de Edge Agent için genişler)
# ============================================================================
BR2_PACKAGE_IPROUTE2=y
BR2_PACKAGE_DBUS=y
BR2_PACKAGE_NFTABLES=y
BR2_PACKAGE_OPENSSL=y
BR2_PACKAGE_LIBOPENSSL=y
BR2_PACKAGE_LIBOPENSSL_BIN=y
BR2_PACKAGE_LIBCURL=y
BR2_PACKAGE_LIBCURL_CURL=y
BR2_PACKAGE_LIBCURL_OPENSSL=y
BR2_PACKAGE_CA_CERTIFICATES=y
# BR2_PACKAGE_DROPBEAR is not set
# BR2_PACKAGE_DROPBEAR_CLIENT is not set
BR2_PACKAGE_UTIL_LINUX=y
BR2_PACKAGE_UTIL_LINUX_BINARIES=y

# ============================================================================
# Time sync — chrony (NTP) + PTP (Faz 2+'da endüstriyel zaman)
# ============================================================================
BR2_PACKAGE_CHRONY=y

# ============================================================================
# Donanım yardımcı araçları
# ============================================================================
# I2C/SPI debug ve test için
BR2_PACKAGE_I2C_TOOLS=y

# Hardware watchdog daemon (busybox watchdog yerine systemd-watchdog kullanılır)
# BR2_PACKAGE_WATCHDOG=n

# GPIO test (Edge Agent geliştirici için)
# BR2_PACKAGE_LIBGPIOD=y
# BR2_PACKAGE_LIBGPIOD_TOOLS=y

# ============================================================================
# Suderra custom paketleri — Faz 2+'da aktif olur
# ============================================================================
BR2_PACKAGE_SUDERRA_OS_INSTALLER=y     # Runtime manifest verifier
BR2_PACKAGE_SUDERRA_KEYS=y             # Runtime trust roots

# RAUC A/B OTA (ADR-0007/ADR-0004) — U-Boot backend, signed-FIT slot hook.
# rauc Config.in, BR2_TARGET_UBOOT ile fw_printenv/setenv'i otomatik select eder.
BR2_PACKAGE_RAUC=y
BR2_PACKAGE_RAUC_DBUS=y
BR2_PACKAGE_RAUC_GPT=y
BR2_PACKAGE_RAUC_JSON=y
BR2_PACKAGE_HOST_RAUC=y
BR2_PACKAGE_SUDERRA_RAUC_CONFIG=y

# TPM 2.0 + encrypted mutable /data at rest (M2, ADR-0007). suderra-data-unlock
# (common overlay) LUKS-opens /data; RevPi seals to the SLB9670 TPM, rpi4 keyfile.
BR2_PACKAGE_TPM2_TSS=y
BR2_PACKAGE_TPM2_TOOLS=y
BR2_PACKAGE_LVM2=y
BR2_PACKAGE_CRYPTSETUP=y
# systemd-cryptsetup + systemd-cryptenroll + TPM2 token handler (RT-5): /data
# LUKS2'nin TPM2-seal ile provision + unlock edilebilmesi için gerekli.
BR2_PACKAGE_SYSTEMD_CRYPTSETUP=y
# Version anti-rollback (M4): rollback-floor / monotonic install guard.
BR2_PACKAGE_SUDERRA_OTA=y
# BR2_PACKAGE_SUDERRA_EDGE_AGENT is not set
# BR2_PACKAGE_SUDERRA_FIRSTBOOT=y      # Faz 2

# ============================================================================
# Sistem kimliği
# ============================================================================
BR2_TARGET_GENERIC_HOSTNAME="suderra-rpi4"
BR2_TARGET_GENERIC_ISSUE="Suderra OS appliance"
# BR2_TARGET_ENABLE_ROOT_LOGIN is not set
# BR2_TARGET_GENERIC_GETTY is not set

# ============================================================================
# Reproducible build
# ============================================================================
BR2_REPRODUCIBLE=y
BR2_PER_PACKAGE_DIRECTORIES=y
```

## configs/suderra_aarch64_rpi4_usb_installer_defconfig
```kconfig
#
# Suderra OS — Raspberry Pi 4 / CM4 USB installer defconfig (aarch64)
#
# This image boots from USB-A media, verifies a signed payload partition, and
# writes suderra-rpi4-target.img.xz to the selected SD/eMMC target.
#

BR2_aarch64=y
BR2_cortex_a72=y
BR2_ARM_FPU_VFPV4=y
BR2_JLEVEL=4
BR2_CCACHE=y
BR2_PACKAGE_SUDERRA_VARIANT_DEV=y

# Toolchain — glibc dynamic, required by Buildroot systemd
BR2_TOOLCHAIN_BUILDROOT=y
BR2_TOOLCHAIN_BUILDROOT_LIBC="glibc"
BR2_TOOLCHAIN_BUILDROOT_GLIBC=y
BR2_TOOLCHAIN_BUILDROOT_CXX=y
BR2_KERNEL_HEADERS_6_12=y
BR2_BINUTILS_VERSION_2_43_X=y
BR2_GCC_VERSION_13_X=y
BR2_TOOLCHAIN_BUILDROOT_LOCALE=y
BR2_TOOLCHAIN_BUILDROOT_USE_SSP=y

# Raspberry Pi downstream kernel with bcm2711 defconfig
BR2_LINUX_KERNEL=y
BR2_LINUX_KERNEL_CUSTOM_TARBALL=y
BR2_LINUX_KERNEL_CUSTOM_TARBALL_LOCATION="$(call github,raspberrypi,linux,576cc10e1ed50a9eacffc7a05c796051d7343ea4)/linux-576cc10e1ed50a9eacffc7a05c796051d7343ea4.tar.gz"
BR2_LINUX_KERNEL_DEFCONFIG="bcm2711"
BR2_LINUX_KERNEL_CONFIG_FRAGMENT_FILES="$(BR2_EXTERNAL_SUDERRA_PATH)/board/suderra/aarch64-rpi4/linux-rpi4.config"
BR2_LINUX_KERNEL_IMAGE=y
BR2_LINUX_KERNEL_NEEDS_HOST_OPENSSL=y
BR2_LINUX_KERNEL_DTS_SUPPORT=y
BR2_LINUX_KERNEL_INTREE_DTS_NAME="broadcom/bcm2711-rpi-4-b broadcom/bcm2711-rpi-cm4 broadcom/bcm2711-rpi-cm4-io"

# Pi 4 firmware
BR2_PACKAGE_RPI_FIRMWARE=y
BR2_PACKAGE_RPI_FIRMWARE_VARIANT_PI4=y
BR2_PACKAGE_RPI_FIRMWARE_CONFIG_FILE="$(BR2_EXTERNAL_SUDERRA_PATH)/board/suderra/aarch64-rpi4/config.txt"
BR2_PACKAGE_RPI_FIRMWARE_CMDLINE_FILE="$(BR2_EXTERNAL_SUDERRA_PATH)/board/suderra/aarch64-rpi4-usb-installer/cmdline.txt"

# Init system
BR2_INIT_SYSTEMD=y
# BR2_PACKAGE_SYSTEMD_LOGIND is not set
BR2_PACKAGE_SYSTEMD_NETWORKD=y
# BR2_PACKAGE_SYSTEMD_TIMESYNCD is not set
# BR2_PACKAGE_SYSTEMD_HOSTNAMED is not set

# Installer rootfs
BR2_TARGET_ROOTFS_EXT2=y
BR2_TARGET_ROOTFS_EXT2_4=y
BR2_TARGET_ROOTFS_EXT2_GEN=4
BR2_TARGET_ROOTFS_EXT2_LABEL="suderra-installer"
BR2_TARGET_ROOTFS_EXT2_SIZE="256M"
BR2_TARGET_ROOTFS_EXT2_INODES=0
BR2_TARGET_ROOTFS_EXT2_RESBLKS=1

# Image production
BR2_PACKAGE_HOST_GENIMAGE=y
BR2_PACKAGE_HOST_DOSFSTOOLS=y
BR2_PACKAGE_HOST_MTOOLS=y

# Rootfs overlay + hooks
BR2_ROOTFS_OVERLAY="$(BR2_EXTERNAL_SUDERRA_PATH)/board/suderra/common/rootfs-overlay"
BR2_ROOTFS_POST_BUILD_SCRIPT="$(BR2_EXTERNAL_SUDERRA_PATH)/board/suderra/common/post-build.sh"
BR2_ROOTFS_POST_IMAGE_SCRIPT="$(BR2_EXTERNAL_SUDERRA_PATH)/board/suderra/common/post-image.sh"
BR2_ROOTFS_POST_SCRIPT_ARGS="suderra_aarch64_rpi4_usb_installer"
BR2_ROOTFS_USERS_TABLES="$(BR2_EXTERNAL_SUDERRA_PATH)/board/suderra/common/users.txt"

# Installer runtime tools
BR2_PACKAGE_IPROUTE2=y
BR2_PACKAGE_DBUS=y
BR2_PACKAGE_NFTABLES=y
BR2_PACKAGE_OPENSSL=y
BR2_PACKAGE_LIBOPENSSL=y
BR2_PACKAGE_LIBOPENSSL_BIN=y
BR2_PACKAGE_CA_CERTIFICATES=y
BR2_PACKAGE_UTIL_LINUX=y
BR2_PACKAGE_UTIL_LINUX_BINARIES=y
BR2_PACKAGE_XZ=y
BR2_PACKAGE_DROPBEAR=y
# BR2_PACKAGE_DROPBEAR_CLIENT is not set
BR2_PACKAGE_DROPBEAR_DISABLE_REVERSEDNS=y
BR2_PACKAGE_CHRONY=y

BR2_PACKAGE_SUDERRA_OS_INSTALLER=y
# BR2_PACKAGE_SUDERRA_EDGE_AGENT is not set
# BR2_PACKAGE_SUDERRA_FIRSTBOOT is not set
# BR2_PACKAGE_SUDERRA_KEYS is not set

BR2_TARGET_GENERIC_HOSTNAME="suderra-usb-installer"
BR2_TARGET_GENERIC_ISSUE="Suderra OS USB installer"
# BR2_TARGET_ENABLE_ROOT_LOGIN is not set
BR2_TARGET_GENERIC_GETTY=y
BR2_TARGET_GENERIC_GETTY_PORT="ttyS0"
BR2_TARGET_GENERIC_GETTY_BAUDRATE_115200=y

BR2_REPRODUCIBLE=y
BR2_PER_PACKAGE_DIRECTORIES=y
```
