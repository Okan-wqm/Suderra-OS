## configs/suderra_qemu_x86_64_defconfig
```kconfig
#
# Suderra OS — QEMU x86_64 defconfig
#
# Faz 1 (ilk bootable imaj) için minimal çalışan içerik.
# Faz 3'te dm-verity, secure boot, lockdown ile sertleştirilir.
#
# Build:
#   ./scripts/build-in-docker.sh suderra_qemu_x86_64_defconfig
# Çalıştır:
#   ./scripts/qemu-run.sh
#
# Hedef: ~80-120 MB ilk denemede, Faz 3 sonu ~50 MB
#

# Architecture
BR2_x86_64=y
BR2_x86_corei7=y
BR2_JLEVEL=4
BR2_CCACHE=y
BR2_PACKAGE_SUDERRA_VARIANT_DEV=y

# Toolchain — glibc dynamic, required by Buildroot systemd
BR2_TOOLCHAIN_BUILDROOT=y
BR2_TOOLCHAIN_BUILDROOT_LIBC="glibc"
BR2_TOOLCHAIN_BUILDROOT_GLIBC=y
BR2_TOOLCHAIN_BUILDROOT_CXX=y
BR2_KERNEL_HEADERS_6_11=y
BR2_BINUTILS_VERSION_2_43_X=y
BR2_GCC_VERSION_13_X=y
BR2_TOOLCHAIN_BUILDROOT_LOCALE=y
BR2_TOOLCHAIN_BUILDROOT_USE_SSP=y

# Kernel — Linux 6.12 LTS (Edge Agent memfd_secret gereksinimi)
BR2_LINUX_KERNEL=y
BR2_LINUX_KERNEL_CUSTOM_VERSION=y
BR2_LINUX_KERNEL_CUSTOM_VERSION_VALUE="6.12.6"
BR2_LINUX_KERNEL_DEFCONFIG="x86_64"
BR2_LINUX_KERNEL_USE_ARCH_DEFAULT_CONFIG=y
BR2_LINUX_KERNEL_CONFIG_FRAGMENT_FILES="$(BR2_EXTERNAL_SUDERRA_PATH)/board/suderra/x86_64/linux-qemu.config"
BR2_LINUX_KERNEL_BZIMAGE=y
BR2_LINUX_KERNEL_INSTALL_TARGET=y

# Kernel hardening fragment (Faz 1: light, Faz 3: strict)
# Şu an Faz 1'de pasif — Faz 3'te common/kernel-fragment.config bu listeye eklenir.

# Init system — systemd minimal
# Edge Agent Type=notify + sd-notify zorunlu kıldığı için sysvinit/finit alternatif değil
BR2_INIT_SYSTEMD=y
BR2_PACKAGE_SYSTEMD_JOURNAL_GATEWAYD=n
# BR2_PACKAGE_SYSTEMD_LOGIND is not set
BR2_PACKAGE_SYSTEMD_NETWORKD=y
BR2_PACKAGE_SYSTEMD_RESOLVED=n
# BR2_PACKAGE_SYSTEMD_TIMESYNCD is not set
# BR2_PACKAGE_SYSTEMD_TIMEDATED is not set
# BR2_PACKAGE_SYSTEMD_HOSTNAMED is not set
# Faz 3'te aktive: BR2_PACKAGE_SYSTEMD_BOOT=y (UEFI Secure Boot için)

# Filesystem — Faz 1: ext4 (kolay debug), Faz 3: erofs + dm-verity
BR2_TARGET_ROOTFS_EXT2=y
BR2_TARGET_ROOTFS_EXT2_4=y
BR2_TARGET_ROOTFS_EXT2_GEN=4
BR2_TARGET_ROOTFS_EXT2_SIZE="256M"
BR2_TARGET_ROOTFS_EXT2_INODES=0
BR2_TARGET_ROOTFS_EXT2_RESBLKS=1

# Image generation
BR2_PACKAGE_HOST_GENIMAGE=y
BR2_PACKAGE_HOST_DOSFSTOOLS=y
BR2_PACKAGE_HOST_MTOOLS=y

# Bootloader — GRUB2 UEFI (QEMU OVMF), Faz 3'te shim ile signed boot
BR2_TARGET_GRUB2=y
BR2_TARGET_GRUB2_X86_64_EFI=y
BR2_TARGET_GRUB2_BUILTIN_MODULES_EFI="boot linux ext2 fat squash4 part_msdos part_gpt normal search efi_gop efi_uga"
BR2_TARGET_GRUB2_BUILTIN_CONFIG_EFI="$(BR2_EXTERNAL_SUDERRA_PATH)/board/suderra/x86_64/grub-qemu.cfg"

# QEMU host modules için (gerçek HW'de gereksiz)
BR2_PACKAGE_QEMU=n
BR2_PACKAGE_HOST_QEMU=n

# Rootfs overlay — /etc/os-release, hostname, init configs
BR2_ROOTFS_OVERLAY="$(BR2_EXTERNAL_SUDERRA_PATH)/board/suderra/common/rootfs-overlay"

# Post-build: rootfs içinde dosya manipülasyonu (os-release populate)
BR2_ROOTFS_POST_BUILD_SCRIPT="$(BR2_EXTERNAL_SUDERRA_PATH)/board/suderra/common/post-build.sh"

# Post-image: image dosyaları hazır, bundle/sign aşaması (Faz 4'te aktif)
BR2_ROOTFS_POST_IMAGE_SCRIPT="$(BR2_EXTERNAL_SUDERRA_PATH)/board/suderra/common/post-image.sh"
BR2_ROOTFS_POST_SCRIPT_ARGS="suderra_qemu_x86_64"

# Suderra environment variables (post-build/image script'lerine geçer)
BR2_ROOTFS_USERS_TABLES="$(BR2_EXTERNAL_SUDERRA_PATH)/board/suderra/common/users.txt"

# BusyBox — Faz 5+'da uutils ile değiştirilebilir
BR2_PACKAGE_BUSYBOX_SHOW_OTHERS=y

# Network tools (Faz 3'te nftables aktive)
BR2_PACKAGE_IPROUTE2=y
BR2_PACKAGE_DBUS=y
BR2_PACKAGE_NFTABLES=y
BR2_PACKAGE_OPENSSL=y
BR2_PACKAGE_LIBCURL=y
BR2_PACKAGE_LIBCURL_CURL=y
BR2_PACKAGE_LIBCURL_OPENSSL=y
BR2_PACKAGE_CA_CERTIFICATES=y
BR2_PACKAGE_DROPBEAR=y
# BR2_PACKAGE_DROPBEAR_CLIENT is not set
BR2_PACKAGE_DROPBEAR_DISABLE_REVERSEDNS=y

# Time sync
BR2_PACKAGE_CHRONY=y

# Suderra custom paketleri
# BR2_PACKAGE_SUDERRA_EDGE_AGENT is not set
# Faz 2'de aktive: BR2_PACKAGE_SUDERRA_FIRSTBOOT=y
# BR2_PACKAGE_SUDERRA_KEYS=y  # Faz 3'te (signing keys)

# Build optimizations
BR2_TARGET_GENERIC_HOSTNAME="suderra"
BR2_TARGET_GENERIC_ISSUE="Suderra OS appliance"
BR2_TARGET_ENABLE_ROOT_LOGIN=y
BR2_TARGET_GENERIC_ROOT_PASSWD="$$6$$suderra$$WEUTfdUxSdlVhtgwmC7hEqyXOBfFi5C99pczs8i8bnKiPd/wwrAntaBnNj1jeErSB260adcV1QZbYhFCSOyRI0"
BR2_TARGET_GENERIC_GETTY=y
BR2_TARGET_GENERIC_GETTY_PORT="ttyS0"
BR2_TARGET_GENERIC_GETTY_BAUDRATE_115200=y

# Reproducible build
BR2_REPRODUCIBLE=y
BR2_PER_PACKAGE_DIRECTORIES=y
```

## configs/suderra_qemu_x86_64_prod_ab_defconfig
```kconfig
#
# Suderra OS — x86_64 production-runtime QEMU A/B defconfig
#
# This is not a public production artifact yet. It is the executable production
# behavior lane for Secure Boot, dm-verity, RAUC A/B, health-gate, and rollback
# evidence. The matrix keeps it out of release publication until those gates
# pass end to end.
#

# Architecture
BR2_x86_64=y
BR2_x86_corei7=y
BR2_JLEVEL=4
BR2_CCACHE=y
BR2_PACKAGE_SUDERRA_VARIANT_PROD=y

# Toolchain
BR2_TOOLCHAIN_BUILDROOT=y
BR2_TOOLCHAIN_BUILDROOT_LIBC="glibc"
BR2_TOOLCHAIN_BUILDROOT_GLIBC=y
BR2_TOOLCHAIN_BUILDROOT_CXX=y
BR2_KERNEL_HEADERS_6_12=y
BR2_BINUTILS_VERSION_2_43_X=y
BR2_GCC_VERSION_13_X=y
BR2_TOOLCHAIN_BUILDROOT_LOCALE=y
BR2_TOOLCHAIN_BUILDROOT_USE_SSP=y

# Kernel
BR2_LINUX_KERNEL=y
BR2_LINUX_KERNEL_CUSTOM_VERSION=y
BR2_LINUX_KERNEL_CUSTOM_VERSION_VALUE="6.12.6"
BR2_LINUX_KERNEL_USE_CUSTOM_CONFIG=y
BR2_LINUX_KERNEL_CUSTOM_CONFIG_FILE="$(BR2_EXTERNAL_SUDERRA_PATH)/board/suderra/x86_64/linux-x86_64.config"
BR2_LINUX_KERNEL_CONFIG_FRAGMENT_FILES="$(BR2_EXTERNAL_SUDERRA_PATH)/board/suderra/common/kernel-fragment.config"
BR2_LINUX_KERNEL_BZIMAGE=y
BR2_LINUX_KERNEL_INSTALL_TARGET=y

# Init system
BR2_INIT_SYSTEMD=y
# BR2_PACKAGE_SYSTEMD_LOGIND is not set
BR2_PACKAGE_SYSTEMD_NETWORKD=y
# BR2_PACKAGE_SYSTEMD_TIMESYNCD is not set
# BR2_PACKAGE_SYSTEMD_HOSTNAMED is not set

# Filesystem
BR2_TARGET_ROOTFS_EXT2=y
BR2_TARGET_ROOTFS_EXT2_4=y
BR2_TARGET_ROOTFS_EXT2_GEN=4
BR2_TARGET_ROOTFS_EXT2_LABEL="suderra-root"
BR2_TARGET_ROOTFS_EXT2_SIZE="512M"
BR2_TARGET_ROOTFS_EXT2_INODES=0
BR2_TARGET_ROOTFS_EXT2_RESBLKS=1

# Image generation
BR2_PACKAGE_HOST_GENIMAGE=y
BR2_PACKAGE_HOST_DOSFSTOOLS=y
BR2_PACKAGE_HOST_MTOOLS=y

# Bootloader
BR2_TARGET_GRUB2=y
BR2_TARGET_GRUB2_X86_64_EFI=y
BR2_TARGET_GRUB2_BUILTIN_MODULES_EFI="boot chain linux ext2 fat squash4 part_msdos part_gpt normal search efi_gop efi_uga loadenv echo halt test regexp"
BR2_TARGET_GRUB2_BUILTIN_CONFIG_EFI="$(BR2_EXTERNAL_SUDERRA_PATH)/board/suderra/x86_64/grub.cfg"
BR2_TARGET_GRUB2_INSTALL_TOOLS=y

# Rootfs overlay + post-build/image
BR2_ROOTFS_OVERLAY="$(BR2_EXTERNAL_SUDERRA_PATH)/board/suderra/common/rootfs-overlay"
BR2_ROOTFS_POST_BUILD_SCRIPT="$(BR2_EXTERNAL_SUDERRA_PATH)/board/suderra/common/post-build.sh"
BR2_ROOTFS_POST_IMAGE_SCRIPT="$(BR2_EXTERNAL_SUDERRA_PATH)/board/suderra/common/post-image.sh"
BR2_ROOTFS_POST_SCRIPT_ARGS="suderra_qemu_x86_64_prod_ab"
BR2_ROOTFS_USERS_TABLES="$(BR2_EXTERNAL_SUDERRA_PATH)/board/suderra/common/users.txt"

# TPM 2.0 and encrypted mutable state
BR2_PACKAGE_TPM2_TSS=y
BR2_PACKAGE_TPM2_TOOLS=y
BR2_PACKAGE_LVM2=y
BR2_PACKAGE_CRYPTSETUP=y
# systemd-cryptsetup + systemd-cryptenroll + TPM2 token handler (RT-5): /data
# LUKS2'nin TPM2-seal ile provision + unlock edilebilmesi için gerekli.
BR2_PACKAGE_SYSTEMD_CRYPTSETUP=y

# RAUC A/B update controller
BR2_PACKAGE_RAUC=y
BR2_PACKAGE_RAUC_DBUS=y
BR2_PACKAGE_RAUC_GPT=y
BR2_PACKAGE_RAUC_JSON=y
BR2_PACKAGE_HOST_RAUC=y

# Network and crypto tools
BR2_PACKAGE_IPROUTE2=y
BR2_PACKAGE_DBUS=y
BR2_PACKAGE_NFTABLES=y
BR2_PACKAGE_OPENSSL=y
BR2_PACKAGE_LIBCURL=y
BR2_PACKAGE_LIBCURL_CURL=y
BR2_PACKAGE_LIBCURL_OPENSSL=y
BR2_PACKAGE_CA_CERTIFICATES=y
# BR2_PACKAGE_DROPBEAR is not set
# BR2_PACKAGE_DROPBEAR_CLIENT is not set

# Time sync
BR2_PACKAGE_CHRONY=y
BR2_PACKAGE_LINUXPTP=y

# Suderra custom packages
BR2_PACKAGE_SUDERRA_OS_INSTALLER=y
BR2_PACKAGE_SUDERRA_KEYS=y
BR2_PACKAGE_SUDERRA_RAUC_CONFIG=y
BR2_PACKAGE_SUDERRA_OTA=y
# BR2_PACKAGE_SUDERRA_EDGE_AGENT is not set
# BR2_PACKAGE_SUDERRA_FIRSTBOOT=y

# Build optimizations
BR2_TARGET_GENERIC_HOSTNAME="suderra"
BR2_TARGET_GENERIC_ISSUE="Suderra OS appliance"
# BR2_TARGET_ENABLE_ROOT_LOGIN is not set
# BR2_TARGET_GENERIC_GETTY is not set

# Reproducible build
BR2_REPRODUCIBLE=y
BR2_PER_PACKAGE_DIRECTORIES=y
```

## configs/suderra_x86_64_defconfig
```kconfig
#
# Suderra OS — x86_64 endüstriyel PC defconfig
#
# Hedef donanım: Endüstriyel x86_64 PC (Advantech UNO-2271G, Siemens IPC227G,
# Kontron, vb.) — kesin model Faz 1 başında netleşir.
#
# QEMU defconfig'inden farklar:
#   - Gerçek NIC driver'ları (Intel I210/I225, Realtek)
#   - NVMe / eMMC / SATA storage
#   - iTCO watchdog
#   - TPM 2.0 (TPM_TIS)
#   - UEFI Secure Boot (Faz 3)
#   - dm-verity zorunlu (Faz 3)
#

# Architecture
BR2_x86_64=y
BR2_x86_corei7=y
BR2_JLEVEL=4
BR2_CCACHE=y
BR2_PACKAGE_SUDERRA_VARIANT_PROD=y

# Toolchain — qemu defconfig ile aynı glibc/systemd tabanı
BR2_TOOLCHAIN_BUILDROOT=y
BR2_TOOLCHAIN_BUILDROOT_LIBC="glibc"
BR2_TOOLCHAIN_BUILDROOT_GLIBC=y
BR2_TOOLCHAIN_BUILDROOT_CXX=y
BR2_KERNEL_HEADERS_6_12=y
BR2_BINUTILS_VERSION_2_43_X=y
BR2_GCC_VERSION_13_X=y
BR2_TOOLCHAIN_BUILDROOT_LOCALE=y
BR2_TOOLCHAIN_BUILDROOT_USE_SSP=y

# Kernel — Linux 6.12 LTS
BR2_LINUX_KERNEL=y
BR2_LINUX_KERNEL_CUSTOM_VERSION=y
BR2_LINUX_KERNEL_CUSTOM_VERSION_VALUE="6.12.6"
BR2_LINUX_KERNEL_USE_CUSTOM_CONFIG=y
BR2_LINUX_KERNEL_CUSTOM_CONFIG_FILE="$(BR2_EXTERNAL_SUDERRA_PATH)/board/suderra/x86_64/linux-x86_64.config"
BR2_LINUX_KERNEL_BZIMAGE=y
BR2_LINUX_KERNEL_INSTALL_TARGET=y

# Init system
BR2_INIT_SYSTEMD=y
# BR2_PACKAGE_SYSTEMD_LOGIND is not set
BR2_PACKAGE_SYSTEMD_NETWORKD=y
# BR2_PACKAGE_SYSTEMD_TIMESYNCD is not set
# BR2_PACKAGE_SYSTEMD_HOSTNAMED is not set

# Filesystem (Faz 3'te erofs+verity'e geçiş)
BR2_TARGET_ROOTFS_EXT2=y
BR2_TARGET_ROOTFS_EXT2_4=y
BR2_TARGET_ROOTFS_EXT2_GEN=4
BR2_TARGET_ROOTFS_EXT2_LABEL="suderra-root"
BR2_TARGET_ROOTFS_EXT2_SIZE="512M"
BR2_TARGET_ROOTFS_EXT2_INODES=0
BR2_TARGET_ROOTFS_EXT2_RESBLKS=1

# Image generation
BR2_PACKAGE_HOST_GENIMAGE=y
BR2_PACKAGE_HOST_DOSFSTOOLS=y
BR2_PACKAGE_HOST_MTOOLS=y

# Bootloader — GRUB2 (Faz 3'te shim chain)
BR2_TARGET_GRUB2=y
BR2_TARGET_GRUB2_X86_64_EFI=y
BR2_TARGET_GRUB2_BUILTIN_MODULES_EFI="boot linux ext2 fat squash4 part_msdos part_gpt normal search efi_gop efi_uga"
BR2_TARGET_GRUB2_BUILTIN_CONFIG_EFI="$(BR2_EXTERNAL_SUDERRA_PATH)/board/suderra/x86_64/grub.cfg"

# Rootfs overlay + post-build/image
BR2_ROOTFS_OVERLAY="$(BR2_EXTERNAL_SUDERRA_PATH)/board/suderra/common/rootfs-overlay"
BR2_ROOTFS_POST_BUILD_SCRIPT="$(BR2_EXTERNAL_SUDERRA_PATH)/board/suderra/common/post-build.sh"
BR2_ROOTFS_POST_IMAGE_SCRIPT="$(BR2_EXTERNAL_SUDERRA_PATH)/board/suderra/common/post-image.sh"
BR2_ROOTFS_POST_SCRIPT_ARGS="suderra_x86_64"
BR2_ROOTFS_USERS_TABLES="$(BR2_EXTERNAL_SUDERRA_PATH)/board/suderra/common/users.txt"

# TPM 2.0 (Faz 3+)
# BR2_PACKAGE_TPM2_TSS=y
# BR2_PACKAGE_TPM2_TOOLS=y

# RAUC — Faz 4'te aktif
# BR2_PACKAGE_RAUC=y

# Network tools
BR2_PACKAGE_IPROUTE2=y
BR2_PACKAGE_DBUS=y
BR2_PACKAGE_NFTABLES=y
BR2_PACKAGE_OPENSSL=y
BR2_PACKAGE_LIBCURL=y
BR2_PACKAGE_LIBCURL_CURL=y
BR2_PACKAGE_LIBCURL_OPENSSL=y
BR2_PACKAGE_CA_CERTIFICATES=y
BR2_PACKAGE_DROPBEAR=y
# BR2_PACKAGE_DROPBEAR_CLIENT is not set
BR2_PACKAGE_DROPBEAR_DISABLE_REVERSEDNS=y

# Time sync (PTP destekli, endüstriyel için kritik)
BR2_PACKAGE_CHRONY=y
BR2_PACKAGE_LINUXPTP=y

# Suderra custom paketleri (Faz 2+)
BR2_PACKAGE_SUDERRA_OS_INSTALLER=y
BR2_PACKAGE_SUDERRA_KEYS=y
# BR2_PACKAGE_SUDERRA_EDGE_AGENT is not set
# BR2_PACKAGE_SUDERRA_FIRSTBOOT=y

# Build optimizations
BR2_TARGET_GENERIC_HOSTNAME="suderra"
BR2_TARGET_GENERIC_ISSUE="Suderra OS appliance"
# Production defconfig: no interactive root login. The provision user
# (board/suderra/common/users.txt) handles first-boot setup via a forced
# command shell; runtime access is through Edge Agent's audit-logged
# control plane. suderra-lockdown locks any remaining shells at runtime.
# BR2_TARGET_ENABLE_ROOT_LOGIN is not set
BR2_TARGET_GENERIC_GETTY=y
BR2_TARGET_GENERIC_GETTY_PORT="ttyS0"
BR2_TARGET_GENERIC_GETTY_BAUDRATE_115200=y

# Reproducible build
BR2_REPRODUCIBLE=y
BR2_PER_PACKAGE_DIRECTORIES=y
```

## package/suderra-attestation/Config.in
```kconfig
config BR2_PACKAGE_SUDERRA_ATTESTATION
	bool "suderra-attestation"
	depends on BR2_PACKAGE_HOST_RUSTC_TARGET_ARCH_SUPPORTS
	depends on BR2_TOOLCHAIN_HAS_THREADS
	select BR2_PACKAGE_HOST_RUSTC
	select BR2_PACKAGE_TPM2_TOOLS
	help
	  TPM 2.0 PCR remote attestation istemcisi (RT-2). PCR 0-7 üzerinden
	  AK ile imzalı tpm2_quote üretir, known-good baseline ile karşılaştırır.
	  tpm2-tools'a shell-out eder (ADR-0009). Always-on servis yok; firstboot
	  (baseline) ve operatör (quote) tarafından çağrılır.

comment "suderra-attestation needs threads and a Rust-supported target"
	depends on !BR2_TOOLCHAIN_HAS_THREADS || !BR2_PACKAGE_HOST_RUSTC_TARGET_ARCH_SUPPORTS
```

## package/suderra-edge-agent/Config.in
```kconfig
config BR2_PACKAGE_SUDERRA_EDGE_AGENT
	bool "suderra-agent"
	depends on BR2_INIT_SYSTEMD
	depends on BR2_PACKAGE_HOST_RUSTC_TARGET_ARCH_SUPPORTS
	depends on BR2_TOOLCHAIN_HAS_THREADS
	select BR2_PACKAGE_HOST_RUSTC
	help
	  Suderra Edge Agent — Rust tabanlı endüstriyel edge daemon.

	  Modbus TCP/RTU master, OPC UA server, MQTT publisher (mTLS),
	  SQLCipher encrypted state, systemd Type=notify watchdog.

	  Hedef: aquaculture monitoring + control.

	  Kaynak repo: github.com/Okan-wqm/aquaculture_platform/sens-api-gateway

	  https://github.com/Okan-wqm/aquaculture_platform

comment "suderra-agent needs systemd, threads, and a Rust-supported target"
	depends on !BR2_INIT_SYSTEMD || !BR2_TOOLCHAIN_HAS_THREADS || !BR2_PACKAGE_HOST_RUSTC_TARGET_ARCH_SUPPORTS
```

## package/suderra-firstboot/Config.in
```kconfig
config BR2_PACKAGE_SUDERRA_FIRSTBOOT
	bool "suderra-firstboot"
	depends on BR2_INIT_SYSTEMD
	depends on BR2_PACKAGE_HOST_RUSTC_TARGET_ARCH_SUPPORTS
	depends on BR2_TOOLCHAIN_HAS_THREADS
	select BR2_PACKAGE_HOST_RUSTC
	help
	  İlk-boot provisioning script.

	  - TPM-sealed disk encryption key oluştur (/data için)
	  - Cihaz seri no okuyup os-release'e yaz
	  - Default config dosyalarını /data'ya kopyala
	  - mTLS provisioning (cihazı cloud'a kaydet)
	  - RAUC health-check: ilk boot başarılı ise mark good
	  - Bir kez çalışır, sonra disable olur (systemd ConditionFirstBoot)

comment "suderra-firstboot needs systemd, threads, and a Rust-supported target"
	depends on !BR2_INIT_SYSTEMD || !BR2_TOOLCHAIN_HAS_THREADS || !BR2_PACKAGE_HOST_RUSTC_TARGET_ARCH_SUPPORTS
```

## package/suderra-ota/Config.in
```kconfig
config BR2_PACKAGE_SUDERRA_OTA
	bool "suderra-ota"
	depends on BR2_INIT_SYSTEMD
	depends on BR2_PACKAGE_HOST_RUSTC_TARGET_ARCH_SUPPORTS
	depends on BR2_TOOLCHAIN_HAS_THREADS
	select BR2_PACKAGE_HOST_RUSTC
	select BR2_PACKAGE_RAUC
	help
	  Production OS update orchestrator. It verifies signed
	  suderra.os-update-manifest.v1 manifests, enforces target and
	  anti-rollback policy, delegates inactive-slot installation to RAUC,
	  and persists typed update evidence under /data.

comment "suderra-ota needs systemd, threads, and a Rust-supported target"
	depends on !BR2_INIT_SYSTEMD || !BR2_TOOLCHAIN_HAS_THREADS || !BR2_PACKAGE_HOST_RUSTC_TARGET_ARCH_SUPPORTS
```
