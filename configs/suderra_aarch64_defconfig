## configs/suderra_aarch64_defconfig
```kconfig
#
# Suderra OS — aarch64 (ARM64) defconfig
#
# Hedef donanım: Revolution Pi / Raspberry Pi CM4 / endüstriyel ARM SBC
# (kesin model Faz 1 sonunda netleşir).
#
# x86_64'ten farklı olarak:
#   - U-Boot bootloader (UEFI değil — extlinux.conf veya FIT image)
#   - Device tree (DTB) — board'a özel
#   - GPIO/I2C/SPI overlay'ler
#   - Watchdog: BCM2835 (Pi CM4) veya board-specific
#

# Architecture
BR2_aarch64=y
BR2_cortex_a72=y
BR2_JLEVEL=4
BR2_CCACHE=y
BR2_PACKAGE_SUDERRA_VARIANT_DEV=y

# Toolchain — glibc dynamic, required by Buildroot systemd
BR2_TOOLCHAIN_BUILDROOT=y
BR2_TOOLCHAIN_BUILDROOT_LIBC="glibc"
BR2_TOOLCHAIN_BUILDROOT_GLIBC=y
BR2_TOOLCHAIN_BUILDROOT_CXX=y
BR2_KERNEL_HEADERS_6_11=y
BR2_BINUTILS_VERSION_2_43_X=y
BR2_GCC_VERSION_13_X=y
BR2_TOOLCHAIN_BUILDROOT_LOCALE=y
BR2_TOOLCHAIN_BUILDROOT_USE_SSP=y

# Kernel — Linux 6.12 LTS
BR2_LINUX_KERNEL=y
BR2_LINUX_KERNEL_CUSTOM_VERSION=y
BR2_LINUX_KERNEL_CUSTOM_VERSION_VALUE="6.12.6"
BR2_LINUX_KERNEL_USE_CUSTOM_CONFIG=y
BR2_LINUX_KERNEL_CUSTOM_CONFIG_FILE="$(BR2_EXTERNAL_SUDERRA_PATH)/board/suderra/aarch64/linux-aarch64.config"
BR2_LINUX_KERNEL_IMAGE=y
BR2_LINUX_KERNEL_INSTALL_TARGET=y

# Device tree — Faz 1 sonu (board kararı sonrası)
# BR2_LINUX_KERNEL_DTS_SUPPORT=y
# BR2_LINUX_KERNEL_INTREE_DTS_NAME="broadcom/bcm2711-rpi-cm4"  # CM4 örnek

# Bootloader — U-Boot
BR2_TARGET_UBOOT=y
BR2_TARGET_UBOOT_BUILD_SYSTEM_KCONFIG=y
BR2_TARGET_UBOOT_FORMAT_BIN=y
# BR2_TARGET_UBOOT_BOARD_DEFCONFIG="rpi_4"  # CM4 örnek (board kararına göre)

# Init system
BR2_INIT_SYSTEMD=y
# BR2_PACKAGE_SYSTEMD_LOGIND is not set
BR2_PACKAGE_SYSTEMD_NETWORKD=y
# BR2_PACKAGE_SYSTEMD_TIMESYNCD is not set
# BR2_PACKAGE_SYSTEMD_HOSTNAMED is not set

# Filesystem (Faz 3'te erofs+verity)
BR2_TARGET_ROOTFS_EXT2=y
BR2_TARGET_ROOTFS_EXT2_4=y
BR2_TARGET_ROOTFS_EXT2_GEN=4
BR2_TARGET_ROOTFS_EXT2_LABEL="suderra-root"
BR2_TARGET_ROOTFS_EXT2_SIZE="256M"
BR2_TARGET_ROOTFS_EXT2_INODES=0
BR2_TARGET_ROOTFS_EXT2_RESBLKS=1

# Image generation
BR2_PACKAGE_HOST_GENIMAGE=y
BR2_PACKAGE_HOST_DOSFSTOOLS=y
BR2_PACKAGE_HOST_MTOOLS=y

# Rootfs overlay
BR2_ROOTFS_OVERLAY="$(BR2_EXTERNAL_SUDERRA_PATH)/board/suderra/common/rootfs-overlay"
BR2_ROOTFS_POST_BUILD_SCRIPT="$(BR2_EXTERNAL_SUDERRA_PATH)/board/suderra/common/post-build.sh"
BR2_ROOTFS_POST_IMAGE_SCRIPT="$(BR2_EXTERNAL_SUDERRA_PATH)/board/suderra/common/post-image.sh"
BR2_ROOTFS_POST_SCRIPT_ARGS="suderra_aarch64"
BR2_ROOTFS_USERS_TABLES="$(BR2_EXTERNAL_SUDERRA_PATH)/board/suderra/common/users.txt"

# Network tools
BR2_PACKAGE_IPROUTE2=y
BR2_PACKAGE_DBUS=y
BR2_PACKAGE_NFTABLES=y
BR2_PACKAGE_OPENSSL=y
BR2_PACKAGE_LIBCURL=y
BR2_PACKAGE_LIBCURL_CURL=y
BR2_PACKAGE_LIBCURL_OPENSSL=y
BR2_PACKAGE_CA_CERTIFICATES=y
BR2_PACKAGE_DROPBEAR=y
# BR2_PACKAGE_DROPBEAR_CLIENT is not set
BR2_PACKAGE_DROPBEAR_DISABLE_REVERSEDNS=y

# Time sync
BR2_PACKAGE_CHRONY=y

# Suderra custom paketleri (Faz 2+)
# BR2_PACKAGE_SUDERRA_EDGE_AGENT is not set
# BR2_PACKAGE_SUDERRA_FIRSTBOOT=y

# Build optimizations
BR2_TARGET_GENERIC_HOSTNAME="suderra"
BR2_TARGET_GENERIC_ISSUE="Suderra OS appliance"
BR2_TARGET_ENABLE_ROOT_LOGIN=y
BR2_TARGET_GENERIC_ROOT_PASSWD="$$6$$suderra$$WEUTfdUxSdlVhtgwmC7hEqyXOBfFi5C99pczs8i8bnKiPd/wwrAntaBnNj1jeErSB260adcV1QZbYhFCSOyRI0"
BR2_TARGET_GENERIC_GETTY=y
BR2_TARGET_GENERIC_GETTY_PORT="ttyS0"
BR2_TARGET_GENERIC_GETTY_BAUDRATE_115200=y

# Reproducible build
BR2_REPRODUCIBLE=y
BR2_PER_PACKAGE_DIRECTORIES=y
```

## configs/suderra_aarch64_revpi4_defconfig
```kconfig
#
# Suderra OS — Revolution Pi Connect 4 defconfig (aarch64)
#
# RevPi Connect 4 is a separate supported hardware target, not a generic CM4
# alias. USB-A self-install depends on device boot configuration; micro-USB
# rpiboot is the official fallback for eMMC flashing.
#

BR2_aarch64=y
BR2_cortex_a72=y
BR2_ARM_FPU_VFPV4=y
BR2_JLEVEL=1
BR2_PACKAGE_SUDERRA_VARIANT_DEV=y

BR2_TOOLCHAIN_BUILDROOT=y
BR2_TOOLCHAIN_BUILDROOT_LIBC="glibc"
BR2_TOOLCHAIN_BUILDROOT_GLIBC=y
BR2_TOOLCHAIN_BUILDROOT_CXX=y
BR2_KERNEL_HEADERS_6_11=y
BR2_BINUTILS_VERSION_2_43_X=y
BR2_GCC_VERSION_13_X=y
BR2_TOOLCHAIN_BUILDROOT_LOCALE=y
BR2_TOOLCHAIN_BUILDROOT_USE_SSP=y

BR2_LINUX_KERNEL=y
BR2_LINUX_KERNEL_CUSTOM_TARBALL=y
BR2_LINUX_KERNEL_CUSTOM_TARBALL_LOCATION="$(call github,raspberrypi,linux,576cc10e1ed50a9eacffc7a05c796051d7343ea4)/linux-576cc10e1ed50a9eacffc7a05c796051d7343ea4.tar.gz"
BR2_LINUX_KERNEL_DEFCONFIG="bcm2711"
BR2_LINUX_KERNEL_CONFIG_FRAGMENT_FILES="$(BR2_EXTERNAL_SUDERRA_PATH)/board/suderra/aarch64-rpi4/linux-rpi4.config"
BR2_LINUX_KERNEL_IMAGE=y
BR2_LINUX_KERNEL_NEEDS_HOST_OPENSSL=y
BR2_LINUX_KERNEL_DTS_SUPPORT=y
BR2_LINUX_KERNEL_INTREE_DTS_NAME="broadcom/bcm2711-rpi-cm4 broadcom/bcm2711-rpi-cm4-io"

BR2_PACKAGE_RPI_FIRMWARE=y
BR2_PACKAGE_RPI_FIRMWARE_VARIANT_PI4=y
BR2_PACKAGE_RPI_FIRMWARE_CONFIG_FILE="$(BR2_EXTERNAL_SUDERRA_PATH)/board/suderra/aarch64-rpi4/config.txt"
BR2_PACKAGE_RPI_FIRMWARE_CMDLINE_FILE="$(BR2_EXTERNAL_SUDERRA_PATH)/board/suderra/aarch64-revpi4/cmdline.txt"

BR2_INIT_SYSTEMD=y
# BR2_PACKAGE_SYSTEMD_LOGIND is not set
BR2_PACKAGE_SYSTEMD_NETWORKD=y
# BR2_PACKAGE_SYSTEMD_TIMESYNCD is not set
# BR2_PACKAGE_SYSTEMD_HOSTNAMED is not set

BR2_TARGET_ROOTFS_EXT2=y
BR2_TARGET_ROOTFS_EXT2_4=y
BR2_TARGET_ROOTFS_EXT2_GEN=4
BR2_TARGET_ROOTFS_EXT2_LABEL="suderra-root"
BR2_TARGET_ROOTFS_EXT2_SIZE="256M"
BR2_TARGET_ROOTFS_EXT2_INODES=0
BR2_TARGET_ROOTFS_EXT2_RESBLKS=1

BR2_PACKAGE_HOST_GENIMAGE=y
BR2_PACKAGE_HOST_DOSFSTOOLS=y
BR2_PACKAGE_HOST_MTOOLS=y

BR2_ROOTFS_OVERLAY="$(BR2_EXTERNAL_SUDERRA_PATH)/board/suderra/common/rootfs-overlay"
BR2_ROOTFS_POST_BUILD_SCRIPT="$(BR2_EXTERNAL_SUDERRA_PATH)/board/suderra/common/post-build.sh"
BR2_ROOTFS_POST_IMAGE_SCRIPT="$(BR2_EXTERNAL_SUDERRA_PATH)/board/suderra/common/post-image.sh"
BR2_ROOTFS_POST_SCRIPT_ARGS="suderra_aarch64_revpi4"
BR2_ROOTFS_USERS_TABLES="$(BR2_EXTERNAL_SUDERRA_PATH)/board/suderra/common/users.txt"

BR2_PACKAGE_IPROUTE2=y
BR2_PACKAGE_DBUS=y
BR2_PACKAGE_NFTABLES=y
BR2_PACKAGE_OPENSSL=y
BR2_PACKAGE_LIBOPENSSL=y
BR2_PACKAGE_LIBOPENSSL_BIN=y
BR2_PACKAGE_LIBCURL=y
BR2_PACKAGE_LIBCURL_CURL=y
BR2_PACKAGE_LIBCURL_OPENSSL=y
BR2_PACKAGE_CA_CERTIFICATES=y
BR2_PACKAGE_DROPBEAR=y
# BR2_PACKAGE_DROPBEAR_CLIENT is not set
BR2_PACKAGE_DROPBEAR_DISABLE_REVERSEDNS=y
BR2_PACKAGE_UTIL_LINUX=y
BR2_PACKAGE_UTIL_LINUX_BINARIES=y
BR2_PACKAGE_CHRONY=y

BR2_PACKAGE_SUDERRA_OS_INSTALLER=y
BR2_PACKAGE_SUDERRA_KEYS=y
# BR2_PACKAGE_SUDERRA_EDGE_AGENT is not set

BR2_TARGET_GENERIC_HOSTNAME="suderra-revpi4"
BR2_TARGET_GENERIC_ISSUE="Suderra OS appliance (RevPi Connect 4)"
# BR2_TARGET_ENABLE_ROOT_LOGIN is not set
BR2_TARGET_GENERIC_GETTY=y
BR2_TARGET_GENERIC_GETTY_PORT="ttyS0"
BR2_TARGET_GENERIC_GETTY_BAUDRATE_115200=y

BR2_REPRODUCIBLE=y
BR2_PER_PACKAGE_DIRECTORIES=y
```

## configs/suderra_aarch64_revpi4_prod_ab_defconfig
```kconfig
#
# Suderra OS — Revolution Pi Connect 4 defconfig (aarch64)
#
# RevPi Connect 4 is a separate supported hardware target, not a generic CM4
# alias. USB-A self-install depends on device boot configuration; micro-USB
# rpiboot is the official fallback for eMMC flashing.
#

BR2_aarch64=y
BR2_cortex_a72=y
BR2_ARM_FPU_VFPV4=y
BR2_JLEVEL=4
BR2_CCACHE=y
BR2_PACKAGE_SUDERRA_VARIANT_PROD=y
BR2_GLOBAL_PATCH_DIR="$(BR2_EXTERNAL_SUDERRA_PATH)/board/suderra/buildroot-hashes"
BR2_DOWNLOAD_FORCE_CHECK_HASHES=y

BR2_TOOLCHAIN_BUILDROOT=y
BR2_TOOLCHAIN_BUILDROOT_LIBC="glibc"
BR2_TOOLCHAIN_BUILDROOT_GLIBC=y
BR2_TOOLCHAIN_BUILDROOT_CXX=y
BR2_KERNEL_HEADERS_6_12=y
BR2_BINUTILS_VERSION_2_43_X=y
BR2_GCC_VERSION_13_X=y
BR2_TOOLCHAIN_BUILDROOT_LOCALE=y
BR2_TOOLCHAIN_BUILDROOT_USE_SSP=y

BR2_LINUX_KERNEL=y
BR2_LINUX_KERNEL_CUSTOM_TARBALL=y
BR2_LINUX_KERNEL_CUSTOM_TARBALL_LOCATION="$(call github,raspberrypi,linux,576cc10e1ed50a9eacffc7a05c796051d7343ea4)/linux-576cc10e1ed50a9eacffc7a05c796051d7343ea4.tar.gz"
BR2_LINUX_KERNEL_DEFCONFIG="bcm2711"
BR2_LINUX_KERNEL_CONFIG_FRAGMENT_FILES="$(BR2_EXTERNAL_SUDERRA_PATH)/board/suderra/aarch64-rpi4/linux-rpi4.config $(BR2_EXTERNAL_SUDERRA_PATH)/board/suderra/aarch64-rpi4/linux-rpi4-hardening.config"
BR2_LINUX_KERNEL_IMAGE=y
BR2_LINUX_KERNEL_NEEDS_HOST_OPENSSL=y
BR2_LINUX_KERNEL_DTS_SUPPORT=y
BR2_LINUX_KERNEL_INTREE_DTS_NAME="broadcom/bcm2711-rpi-cm4 broadcom/bcm2711-rpi-cm4-io"

# U-Boot — signed-FIT root of trust (ADR-0007 G1). BUILD-ONLY until PR-A4
# flips config.txt to chainload u-boot.bin. RevPi Connect 4 is a BCM2711/CM4
# board, so it shares the rpi_arm64 U-Boot defconfig and the shared fragment.
BR2_TARGET_UBOOT=y
BR2_TARGET_UBOOT_BUILD_SYSTEM_KCONFIG=y
BR2_TARGET_UBOOT_BOARD_DEFCONFIG="rpi_arm64"
BR2_TARGET_UBOOT_CONFIG_FRAGMENT_FILES="$(BR2_EXTERNAL_SUDERRA_PATH)/board/suderra/aarch64-rpi4/uboot-fragment.config"
BR2_TARGET_UBOOT_NEEDS_OPENSSL=y
BR2_TARGET_UBOOT_NEEDS_DTC=y
BR2_TARGET_UBOOT_FORMAT_BIN=y
BR2_TARGET_UBOOT_FORMAT_DTB=y
BR2_PACKAGE_HOST_UBOOT_TOOLS=y
BR2_PACKAGE_HOST_UBOOT_TOOLS_FIT_SUPPORT=y
BR2_PACKAGE_HOST_UBOOT_TOOLS_FIT_SIGNATURE_SUPPORT=y

BR2_PACKAGE_RPI_FIRMWARE=y
BR2_PACKAGE_RPI_FIRMWARE_VARIANT_PI4=y
BR2_PACKAGE_RPI_FIRMWARE_CONFIG_FILE="$(BR2_EXTERNAL_SUDERRA_PATH)/board/suderra/aarch64-rpi4/config.txt"
BR2_PACKAGE_RPI_FIRMWARE_CMDLINE_FILE="$(BR2_EXTERNAL_SUDERRA_PATH)/board/suderra/aarch64-revpi4/cmdline.txt"

BR2_INIT_SYSTEMD=y
# BR2_PACKAGE_SYSTEMD_LOGIND is not set
BR2_PACKAGE_SYSTEMD_NETWORKD=y
# BR2_PACKAGE_SYSTEMD_TIMESYNCD is not set
# BR2_PACKAGE_SYSTEMD_HOSTNAMED is not set

BR2_TARGET_ROOTFS_EXT2=y
BR2_TARGET_ROOTFS_EXT2_4=y
BR2_TARGET_ROOTFS_EXT2_GEN=4
BR2_TARGET_ROOTFS_EXT2_LABEL="suderra-root"
BR2_TARGET_ROOTFS_EXT2_SIZE="256M"
BR2_TARGET_ROOTFS_EXT2_INODES=0
BR2_TARGET_ROOTFS_EXT2_RESBLKS=1

BR2_PACKAGE_HOST_GENIMAGE=y
BR2_PACKAGE_HOST_DOSFSTOOLS=y
BR2_PACKAGE_HOST_MTOOLS=y

BR2_ROOTFS_OVERLAY="$(BR2_EXTERNAL_SUDERRA_PATH)/board/suderra/common/rootfs-overlay"
BR2_ROOTFS_POST_BUILD_SCRIPT="$(BR2_EXTERNAL_SUDERRA_PATH)/board/suderra/common/post-build.sh"
BR2_ROOTFS_POST_IMAGE_SCRIPT="$(BR2_EXTERNAL_SUDERRA_PATH)/board/suderra/common/post-image.sh"
BR2_ROOTFS_POST_SCRIPT_ARGS="suderra_aarch64_revpi4_prod_ab"
BR2_ROOTFS_USERS_TABLES="$(BR2_EXTERNAL_SUDERRA_PATH)/board/suderra/common/users.txt"

BR2_PACKAGE_IPROUTE2=y
BR2_PACKAGE_DBUS=y
BR2_PACKAGE_NFTABLES=y
BR2_PACKAGE_OPENSSL=y
BR2_PACKAGE_LIBOPENSSL=y
BR2_PACKAGE_LIBOPENSSL_BIN=y
BR2_PACKAGE_LIBCURL=y
BR2_PACKAGE_LIBCURL_CURL=y
BR2_PACKAGE_LIBCURL_OPENSSL=y
BR2_PACKAGE_CA_CERTIFICATES=y
# BR2_PACKAGE_DROPBEAR is not set
# BR2_PACKAGE_DROPBEAR_CLIENT is not set
BR2_PACKAGE_UTIL_LINUX=y
BR2_PACKAGE_UTIL_LINUX_BINARIES=y
BR2_PACKAGE_CHRONY=y

BR2_PACKAGE_SUDERRA_OS_INSTALLER=y
BR2_PACKAGE_SUDERRA_KEYS=y

# RAUC A/B OTA (ADR-0007/ADR-0004) — U-Boot backend, signed-FIT slot hook.
# rauc Config.in, BR2_TARGET_UBOOT ile fw_printenv/setenv'i otomatik select eder.
BR2_PACKAGE_RAUC=y
BR2_PACKAGE_RAUC_DBUS=y
BR2_PACKAGE_RAUC_GPT=y
BR2_PACKAGE_RAUC_JSON=y
BR2_PACKAGE_HOST_RAUC=y
BR2_PACKAGE_SUDERRA_RAUC_CONFIG=y

# TPM 2.0 + encrypted mutable /data at rest (M2, ADR-0007). suderra-data-unlock
# (common overlay) LUKS-opens /data; RevPi seals to the SLB9670 TPM, rpi4 keyfile.
BR2_PACKAGE_TPM2_TSS=y
BR2_PACKAGE_TPM2_TOOLS=y
BR2_PACKAGE_LVM2=y
BR2_PACKAGE_CRYPTSETUP=y
# systemd-cryptsetup + systemd-cryptenroll + TPM2 token handler (RT-5): /data
# LUKS2'nin TPM2-seal ile provision + unlock edilebilmesi için gerekli.
BR2_PACKAGE_SYSTEMD_CRYPTSETUP=y
# Version anti-rollback (M4): rollback-floor / monotonic install guard.
BR2_PACKAGE_SUDERRA_OTA=y
# BR2_PACKAGE_SUDERRA_EDGE_AGENT is not set

BR2_TARGET_GENERIC_HOSTNAME="suderra-revpi4"
BR2_TARGET_GENERIC_ISSUE="Suderra OS appliance (RevPi Connect 4)"
# BR2_TARGET_ENABLE_ROOT_LOGIN is not set
# BR2_TARGET_GENERIC_GETTY is not set

BR2_REPRODUCIBLE=y
BR2_PER_PACKAGE_DIRECTORIES=y
```
